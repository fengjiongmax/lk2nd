// SPDX-License-Identifier: GPL-2.0-only

/dts-v1/;

#include <skeleton.dtsi>

/ {
	qcom,msm-id = <0xce 0x00 0xf8 0x00 0xf9 0x00 0xfa 0x00>;
	qcom,board-id = <0x08 0x1e>;
	model = "Vivo Y31 (PD1505)";
	compatible = "vivo,pd1505", "qcom,msm8916", "lk2nd,device";
};
