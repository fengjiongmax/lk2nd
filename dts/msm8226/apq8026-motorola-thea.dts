// SPDX-License-Identifier: GPL-2.0-only

/dts-v1/;

#include <skeleton.dtsi>
#include "../msm8916/motorola-carrier-channel-ids.dtsi"

/ {
	// This is used by the bootloader to find the correct DTB
	compatible = "motorola,thea", "qcom,apq8026", "lk2nd,device";
	qcom,msm-id = <199 0x84>;
    qcom,board-id = <131072 0xa>;

	model = "Motorola Moto G LTE (Thea)";
};
